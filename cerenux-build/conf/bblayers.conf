## cerenux-build/conf/bblayers.conf
```bitbake
# LAYER_CONF_VERSION is increased each time build/conf/bblayers.conf
# changes incompatibly
LCONF_VERSION = "7"

BBPATH = "${TOPDIR}"
BBFILES ?= ""

#dawod : i removed the (meta-kernel & meta-bsp & meta-distro) temporary
BBLAYERS ?= " \
  /home/dawod/development/openembedded-core/meta \
  /home/dawod/development/meta-openembedded/meta-oe \
  /home/dawod/development/meta-openembedded/meta-multimedia \
  /home/dawod/development/meta-intel \
  /home/dawod/development/meta-qt5 \
  /home/dawod/development/cerenux/meta-image \
  /home/dawod/development/cerenux/meta-distro \
  "


BBLAYERS_NON_REMOVABLE ?= " \
  /home/dawod/development/openembedded-core/meta \
  "
```

## meta-distro/conf/distro/cerenux.conf
```bitbake
DISTRO = "cerenux"
DISTRO_NAME = "cerenux (Cerebrus Custom Distro)"
DISTRO_VERSION = "0.0.0"
DISTRO_CODENAME = "sumo"
SDK_VENDOR = "-cerenuxsdk"
SDK_VERSION := "${@'${DISTRO_VERSION}'.replace('snapshot-${DATE}','snapshot')}"

MAINTAINER = "Mohamed Dawod <mhm.dawod@gmail.com>"

TARGET_VENDOR = "-cerebrus"

LOCALCONF_VERSION = "1"

# Override these in cerenux based distros
CERENUX_DEFAULT_DISTRO_FEATURES = "largefile opengl ptest multiarch wayland"
CERENUX_DEFAULT_EXTRA_RDEPENDS = "packagegroup-core-boot"
CERENUX_DEFAULT_EXTRA_RRECOMMENDS = "kernel-module-af-packet"

DISTRO_FEATURES ?= "${DISTRO_FEATURES_DEFAULT} ${DISTRO_FEATURES_LIBC} ${CERENUX_DEFAULT_DISTRO_FEATURES}"
DISTRO_EXTRA_RDEPENDS += " ${CERENUX_DEFAULT_EXTRA_RDEPENDS}"
DISTRO_EXTRA_RRECOMMENDS += " ${CERENUX_DEFAULT_EXTRA_RRECOMMENDS}"

SDK_NAME = "${DISTRO}-${TCLIBC}-${SDK_ARCH}-${IMAGE_BASENAME}-${TUNE_PKGARCH}"
SDKPATH = "/opt/${DISTRO}/${SDK_VERSION}"



PREFERRED_VERSION_linux-yocto ?= "4.1%"
TCLIBCAPPEND = ""


PREMIRRORS ??= "\
bzr://.*/.*   http://downloads.yoctoproject.org/mirror/sources/ \n \
cvs://.*/.*   http://downloads.yoctoproject.org/mirror/sources/ \n \
git://.*/.*   http://downloads.yoctoproject.org/mirror/sources/ \n \
gitsm://.*/.* http://downloads.yoctoproject.org/mirror/sources/ \n \
hg://.*/.*    http://downloads.yoctoproject.org/mirror/sources/ \n \
osc://.*/.*   http://downloads.yoctoproject.org/mirror/sources/ \n \
p4://.*/.*    http://downloads.yoctoproject.org/mirror/sources/ \n \
svn://.*/.*   http://downloads.yoctoproject.org/mirror/sources/ \n"

MIRRORS =+ "\
ftp://.*/.*      http://downloads.yoctoproject.org/mirror/sources/ \n \
http://.*/.*     http://downloads.yoctoproject.org/mirror/sources/ \n \
https://.*/.*    http://downloads.yoctoproject.org/mirror/sources/ \n"

# The CONNECTIVITY_CHECK_URI's are used to test whether we can succesfully
# fetch from the network (and warn you if not). To disable the test set
# the variable to be empty.
# Git example url: git://git.yoctoproject.org/yocto-firewall-test;protocol=git;rev=master
CONNECTIVITY_CHECK_URIS ?= "https://www.example.com/"



# Default hash policy for distro
BB_SIGNATURE_HANDLER ?= 'OEBasicHash'
#
# OELAYOUT_ABI allows us to notify users when the format of TMPDIR changes in 
# an incompatible way. Such changes should usually be detailed in the commit
# that breaks the format and have been previously discussed on the mailing list 
# with general agreement from the core team.
#
OELAYOUT_ABI = "11"

# QA check settings - a little stricter than the OE-Core defaults
WARN_TO_ERROR_QA = "already-stripped compile-host-path install-host-path \
                    installed-vs-shipped ldflags pn-overrides rpaths staticdev \
                    useless-rpaths"
WARN_QA_remove = "${WARN_TO_ERROR_QA}"
ERROR_QA_append = " ${WARN_TO_ERROR_QA}"
```

## meta-distro/conf/layer.conf
```bitbake
# We have a conf and classes directory, add to BBPATH
BBPATH .= ":${LAYERDIR}"

# We have recipes-* directories, add to BBFILES
BBFILES += "${LAYERDIR}/recipes-*/*/*.bb \
            ${LAYERDIR}/recipes-*/*/*.bbappend"

BBFILE_COLLECTIONS += "distro"
BBFILE_PATTERN_distro = "^${LAYERDIR}/"
LAYERVERSION_distro = "4"
LAYERSERIES_COMPAT_distro = "sumo"
BBFILE_PRIORITY_distro = "10"
```

## meta-image/conf/layer.conf
```bitbake
# We have a conf and classes directory, add to BBPATH
BBPATH .= ":${LAYERDIR}"

# We have recipes-* directories, add to BBFILES
BBFILES += "${LAYERDIR}/recipes-*/*/*.bb \
            ${LAYERDIR}/recipes-*/*/*.bbappend"

BBFILE_COLLECTIONS += "image"
BBFILE_PATTERN_image = "^${LAYERDIR}/"
LAYERVERSION_image = "4"
LAYERSERIES_COMPAT_image = "sumo"
BBFILE_PRIORITY_image = "10"
```
